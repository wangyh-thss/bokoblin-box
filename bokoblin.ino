#include <PWMServo.h>
#include <PCM.h>

PWMServo servo;

const int piezoPin = A0;
const int piezoThreshold = 20;
const int servoInitPos = 93;
const int servoMaxPos = 158;
const int redPin = 3;
const int greenPin = 5;
const int bluePin = 6;
const int led5Pin = 12;
bool processing = false;
bool boxOpened = false;

const unsigned char openAudio[] PROGMEM = {
    126, 129, 133, 128, 120, 122, 132, 137, 131, 121, 116, 128,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 127, 128};

const unsigned char closeAudio[] PROGMEM = {
    126, 126, 127, 127, 127, 128, 128, 128, 128, 128, 128, 127,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 127, 127};

void showColor(int red, int green, int blue)
{
  analogWrite(greenPin, 255 - green);
  analogWrite(redPin, 255 - red);
  analogWrite(bluePin, 255 - blue);
}

void openBox()
{
  showColor(255, 160, 0); // Yellow

  startPlayback(openAudio, sizeof(openAudio));
  delay(2000);
  stopPlayback();

  servo.attach(SERVO_PIN_A);
  for (int i = servoInitPos; i <= 115; i++)
  {
    servo.write(i);
    delay(10);
  }
  for (int i = 116; i <= servoMaxPos; i++)
  {
    servo.write(i);
    delay(i - 100);
  }
  servo.detach();

  boxOpened = true;
}

void closeBox()
{
  servo.attach(SERVO_PIN_A);
  for (int i = servoMaxPos; i >= servoInitPos; i--)
  {
    servo.write(i);
    delay(15);
  }
  servo.detach();

  startPlayback(closeAudio, sizeof(closeAudio));
  delay(2000);
  stopPlayback();

  showColor(180, 10, 255); // Purple

  boxOpened = false;
}

void setup()
{
  pinMode(piezoPin, INPUT);
  pinMode(redPin, OUTPUT);
  pinMode(greenPin, OUTPUT);
  pinMode(bluePin, OUTPUT);
  pinMode(led5Pin, OUTPUT);

  servo.attach(SERVO_PIN_A);
  servo.write(servoInitPos);
  delay(1000);
  servo.detach();

  showColor(180, 10, 255); // Purple
}

void loop()
{
  int piezoValue = analogRead(piezoPin);
  if (piezoValue >= piezoThreshold && !processing)
  {
    processing = true;
    if (boxOpened)
    {
      closeBox();
    }
    else
    {
      openBox();
    }
    delay(2000);
    processing = false;
  }
}
